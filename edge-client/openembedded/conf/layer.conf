## edge-client/openembedded/conf/layer.conf
```bitbake
BBPATH .= ":${LAYERDIR}"
BBFILES += "${LAYERDIR}/recipes-*/*/*.bb"
BBFILE_COLLECTIONS += "meta-sui-edge"
BBFILE_PATTERN_meta-sui-edge = "^${LAYERDIR}/"
BBFILE_PRIORITY_meta-sui-edge = "6"

LAYERVERSION_meta-sui-edge = "1"
LAYERDEPENDS_meta-sui-edge = "core openembedded-layer"
LAYERSERIES_COMPAT_meta-sui-edge = "scarthgap"
```

## suifleet-edge/meta-suifleet-integration/conf/layer.conf
```bitbake
BBPATH .= ":${LAYERDIR}"
BBFILES += "${LAYERDIR}/recipes-*/*/*.bb ${LAYERDIR}/recipes-*/*/*.bbappend"
BBFILE_COLLECTIONS += "suifleet-integration"
BBFILE_PATTERN_suifleet-integration = "^${LAYERDIR}/"
BBFILE_PRIORITY_suifleet-integration = "6"
LAYERVERSION_suifleet-integration = "1"
LAYERDEPENDS_suifleet-integration = "meta-suifleet raspberrypi"
LAYERSERIES_COMPAT_suifleet-integration = "scarthgap wrynose"
```

## suifleet-edge/meta-suifleet/conf/layer.conf
```bitbake
BBPATH .= ":${LAYERDIR}"
BBFILES += "${LAYERDIR}/recipes-*/*/*.bb"
BBFILES += "${LAYERDIR}/recipes-*/*/*.bbappend"
BBFILE_COLLECTIONS += "meta-suifleet"
BBFILE_PATTERN_meta-suifleet = "^${LAYERDIR}/"
BBFILE_PRIORITY_meta-suifleet = "6"

LAYERVERSION_meta-suifleet = "1"
LAYERDEPENDS_meta-suifleet = "core openembedded-layer scarthgap-rust-mixin"
LAYERSERIES_COMPAT_meta-suifleet = "scarthgap"
```
