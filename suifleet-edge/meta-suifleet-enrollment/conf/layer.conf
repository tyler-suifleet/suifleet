## suifleet-edge/meta-suifleet-enrollment/conf/layer.conf
```bitbake
BBPATH .= ":${LAYERDIR}"
BBFILES += "${LAYERDIR}/recipes-*/*/*.bb ${LAYERDIR}/recipes-*/*/*.bbappend"
BBFILE_COLLECTIONS += "suifleet-enrollment"
BBFILE_PATTERN_suifleet-enrollment = "^${LAYERDIR}/"
BBFILE_PRIORITY_suifleet-enrollment = "6"
LAYERVERSION_suifleet-enrollment = "1"
LAYERDEPENDS_suifleet-enrollment = "meta-suifleet"
LAYERSERIES_COMPAT_suifleet-enrollment = "kirkstone scarthgap wrynose"
```

## suifleet-edge/packaging/buildroot/configs/suifleet_x86_64_musl_defconfig
```kconfig
BR2_x86_64=y
BR2_TOOLCHAIN_EXTERNAL=y
BR2_TOOLCHAIN_EXTERNAL_BOOTLIN=y
BR2_TOOLCHAIN_EXTERNAL_BOOTLIN_X86_64_MUSL_STABLE=y
BR2_DOWNLOAD_FORCE_CHECK_HASHES=y
BR2_PACKAGE_SUIFLEET=y
BR2_TARGET_ROOTFS_CPIO=y
# BR2_TARGET_ROOTFS_TAR is not set
```

## suifleet-edge/packaging/buildroot/package/suifleet/Config.in
```kconfig
config BR2_PACKAGE_SUIFLEET
	bool "suifleet"
	depends on BR2_PACKAGE_HOST_RUSTC_TARGET_ARCH_SUPPORTS
	depends on BR2_TOOLCHAIN_USES_GLIBC || BR2_TOOLCHAIN_USES_MUSL
	depends on BR2_USE_MMU # python3
	depends on BR2_USE_WCHAR # python3
	depends on BR2_TOOLCHAIN_HAS_THREADS # python3
	depends on !BR2_STATIC_LIBS # python3
	select BR2_PACKAGE_HOST_RUSTC
	select BR2_PACKAGE_PYTHON3
	select BR2_PACKAGE_CA_CERTIFICATES
	help
	  SuiFleet edge client with the portable signing service.
	  Provision a unique identity and install fleet configuration at
	  runtime. BusyBox and SysV init can start the paired service.
```
